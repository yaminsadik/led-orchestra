## matter-prototype/controller-node/main/Kconfig.projbuild
```kconfig
menu "LED Orchestra Controller"

    choice LED_ORCHESTRA_OPERATOR_WIFI_MODE
        prompt "Operator Wi-Fi ingress mode"
        default LED_ORCHESTRA_OPERATOR_WIFI_MODE_AP
        help
            Select how laptop/mobile clients reach the controller node over
            Wi-Fi. USB serial is always the baseline ingress. LED nodes remain
            controlled over Thread/Matter by the controller node.

        config LED_ORCHESTRA_OPERATOR_WIFI_MODE_DISABLED
            bool "Disabled"

        config LED_ORCHESTRA_OPERATOR_WIFI_MODE_AP
            bool "Private controller AP"

        config LED_ORCHESTRA_OPERATOR_WIFI_MODE_STA
            bool "Station on private/local network"
    endchoice

    config ENABLE_WIFI_AP
        bool
        default n
        help
            CHIP/ESP32 Wi-Fi commissioning softAP. This MUST stay disabled for
            the LED Orchestra controller. Enabling it makes
            CHIP_DEVICE_CONFIG_ENABLE_WIFI non-zero, which hands the Wi-Fi
            interface to the Matter connectivity manager. Because this node
            commissions over Thread, CHIP then forces the radio to STA and stops
            the AP. The operator ingress AP is a standalone esp_wifi softAP in
            controller_wifi_ingress.cpp and does not use this CHIP option.

    config ENABLE_WIFI_TELEMETRY
        bool
        default n

    config WIFI_STATION_RECONNECT_INTERVAL
        int
        default 100

    config MAX_SCAN_NETWORKS_RESULTS
        int
        default 10

    config WIFI_SCAN_COMPLETION_TIMEOUT
        int
        default 10000

    config WIFI_CONNECTIVITY_TIMEOUT
        int
        default 30000

    config DEFAULT_WIFI_SSID
        string
        default ""

    config DEFAULT_WIFI_PASSWORD
        string
        default ""

    config LED_ORCHESTRA_WIFI_AP_SSID
        string "Controller AP SSID"
        depends on LED_ORCHESTRA_OPERATOR_WIFI_MODE_AP
        default "led-orchestra-setup"
        help
            Placeholder fallback only. Set the real SSID in the gitignored
            sdkconfig.defaults.local (see sdkconfig.defaults.local.example).

    config LED_ORCHESTRA_WIFI_AP_PASSWORD
        string "Controller AP password"
        depends on LED_ORCHESTRA_OPERATOR_WIFI_MODE_AP
        default ""
        help
            Leave empty here. Set a STRONG password (8-63 chars for WPA2-PSK) in
            the gitignored sdkconfig.defaults.local. An empty password falls back
            to an open development AP and must not be used operationally.

    config LED_ORCHESTRA_WIFI_AP_CHANNEL
        int "Controller AP channel"
        depends on LED_ORCHESTRA_OPERATOR_WIFI_MODE_AP
        range 1 13
        default 6

    config LED_ORCHESTRA_WIFI_AP_MAX_CONNECTIONS
        int "Controller AP max clients"
        depends on LED_ORCHESTRA_OPERATOR_WIFI_MODE_AP
        range 1 8
        default 4

    config LED_ORCHESTRA_WIFI_STA_SSID
        string "Station SSID"
        depends on LED_ORCHESTRA_OPERATOR_WIFI_MODE_STA
        default ""

    config LED_ORCHESTRA_WIFI_STA_PASSWORD
        string "Station password"
        depends on LED_ORCHESTRA_OPERATOR_WIFI_MODE_STA
        default ""

endmenu
```

## matter-prototype/controller-node/sdkconfig.defaults
```kconfig
# ESP32-C6 dedicated Matter controller-node prototype target.
# This node is the Matter controller/commissioner and local source of truth.
# USB serial is the baseline operator ingress; controller-local Wi-Fi is planned
# as a convenience ingress for laptop/mobile clients. LED nodes remain operated
# over Thread/Matter by this controller, with no internet requirement. In the
# OTA phase this node also becomes the Matter OTA Provider for operator-loaded
# signed/encrypted images.
CONFIG_IDF_TARGET="esp32c6"
CONFIG_ESPTOOLPY_FLASHSIZE_4MB=y

CONFIG_BT_ENABLED=y
CONFIG_BT_NIMBLE_ENABLED=y
# Required by ESP-Matter controller shell for `pairing ble-thread`: the
# controller commissions Thread LED nodes over BLE, then hands them the Thread
# operational dataset for normal Matter-over-Thread control.
CONFIG_ENABLE_ESP32_BLE_CONTROLLER=y

# Route the interactive ESP console shell over the ESP32-C6 native USB
# Serial/JTAG port. Without this, logs can appear in idf.py monitor while shell
# input is routed to another console backend.
CONFIG_ESP_CONSOLE_USB_SERIAL_JTAG=y
CONFIG_ESP_CONSOLE_USB_SERIAL_JTAG_ENABLED=y

# Keep `idf.py monitor` readable. Default runtime log level is WARN so the noisy
# `wifi:`, `chip[...]`, and `OPENTHREAD` info lines stay quiet, while any
# WARN/ERROR still prints. INFO is still compiled in (LOG_MAXIMUM_LEVEL_INFO) so
# app_main can re-raise the LED Orchestra tags (lo_controller / lo_wifi_ingress /
# lo_console) to INFO at runtime for operator breadcrumbs. To debug deeply, run
# `log level * verbose` in the shell or raise the level in menuconfig.
CONFIG_LOG_DEFAULT_LEVEL_WARN=y
CONFIG_LOG_MAXIMUM_LEVEL_INFO=y

CONFIG_OPENTHREAD_ENABLED=y
CONFIG_OPENTHREAD_RADIO_NATIVE=y
# Current-prototype config. Border-router mode enables the OpenThread SRP server
# so Matter-over-Thread devices can publish their operational services locally,
# and the SRP/DNS clients let this single SoC attempt on-device discovery.
# NOTE (resolved 2026-06-02): a single infra-less C6 cannot answer its own DNS-SD
# queries, so this on-device path does not complete commissioning. The locked
# direction is a real border router (Hub C6 + RCP, Option 2); see
# ../../docs/controller-topology-adr.md. Kept here as the prototype baseline for
# the Phase 4 validation. Wi-Fi stays operator ingress only; LED nodes are
# controlled over Thread.
CONFIG_OPENTHREAD_BORDER_ROUTER=y
CONFIG_OPENTHREAD_SRP_CLIENT=y
CONFIG_OPENTHREAD_DNS_CLIENT=y
CONFIG_OPENTHREAD_LOG_LEVEL_NOTE=y
CONFIG_OPENTHREAD_CLI=y
CONFIG_THREAD_TASK_STACK_SIZE=8192

# Default operator Wi-Fi ingress is a private AP hosted by the controller node.
# USB serial remains the recovery/baseline ingress. Station mode is supported by
# the project Kconfig for private/local network deployments, but should be
# enabled deliberately with an SSID/password after the venue network constraints
# are known. LED nodes remain Thread/Matter devices.
# The operator AP is a standalone esp_wifi softAP (controller_wifi_ingress.cpp).
# CHIP's own Wi-Fi must stay OFF: ENABLE_WIFI_AP/STATION both off keep
# CHIP_DEVICE_CONFIG_ENABLE_WIFI==0 so the Matter connectivity manager never
# grabs the radio and forces STA (which would stop our AP). LED nodes are
# commissioned and controlled over Thread.
CONFIG_ESP_WIFI_ENABLED=y
CONFIG_LED_ORCHESTRA_OPERATOR_WIFI_MODE_AP=y
CONFIG_ENABLE_WIFI_AP=n
CONFIG_ENABLE_WIFI_STATION=n
CONFIG_USE_MINIMAL_MDNS=n

# Operator AP SSID/password are intentionally NOT set here. They live in the
# gitignored sdkconfig.defaults.local (see sdkconfig.defaults.local.example) so
# credentials never enter version control.
CONFIG_LED_ORCHESTRA_WIFI_AP_CHANNEL=6
CONFIG_LED_ORCHESTRA_WIFI_AP_MAX_CONNECTIONS=4
CONFIG_DEFAULT_WIFI_SSID=""
CONFIG_DEFAULT_WIFI_PASSWORD=""

CONFIG_PARTITION_TABLE_CUSTOM=y
CONFIG_PARTITION_TABLE_FILENAME="partitions.csv"

CONFIG_ENABLE_CHIP_SHELL=y
CONFIG_ESP_MATTER_CONSOLE_TASK_STACK=4096

CONFIG_LWIP_HOOK_IP6_ROUTE_DEFAULT=y
CONFIG_LWIP_HOOK_ND6_GET_GW_DEFAULT=y
CONFIG_LWIP_IPV6_AUTOCONFIG=y
CONFIG_LWIP_IPV6_FORWARD=y
CONFIG_LWIP_IPV6_NUM_ADDRESSES=12
CONFIG_LWIP_MULTICAST_PING=y
CONFIG_LWIP_NETIF_STATUS_CALLBACK=y

CONFIG_CHIP_TASK_STACK_SIZE=15360
CONFIG_ESP_MAIN_TASK_STACK_SIZE=10240
CONFIG_NUM_UDP_ENDPOINTS=16
CONFIG_CHIP_SHELL_CMD_LINE_BUF_MAX_LENGTH=512
CONFIG_CHIP_PROJECT_CONFIG="main/matter_project_config.h"

CONFIG_ENABLE_CHIP_CONTROLLER_BUILD=y
CONFIG_ESP_MATTER_CONTROLLER_ENABLE=y
CONFIG_ESP_MATTER_ENABLE_MATTER_SERVER=n
CONFIG_ESP_MATTER_COMMISSIONER_ENABLE=y
CONFIG_MBEDTLS_KEY_EXCHANGE_ECJPAKE=y
CONFIG_MBEDTLS_ECJPAKE_C=y
CONFIG_MBEDTLS_SSL_PROTO_DTLS=y
CONFIG_MBEDTLS_HKDF_C=y
CONFIG_ENABLE_ROUTE_HOOK=n
CONFIG_WIFI_NETWORK_COMMISSIONING_DRIVER=n
CONFIG_THREAD_NETWORK_COMMISSIONING_DRIVER=n

CONFIG_USE_TEST_SETUP_PIN_CODE=20212020
CONFIG_USE_TEST_SETUP_DISCRIMINATOR=0xF0
```

## matter-prototype/controller-node/sdkconfig.defaults.local.example
```kconfig
# Template for controller operator Wi-Fi AP credentials.
#
# Setup:
#   1. cp sdkconfig.defaults.local.example sdkconfig.defaults.local
#   2. Set a unique SSID and a STRONG password (8-63 chars for WPA2-PSK).
#   3. Delete the generated sdkconfig and rebuild so the values are applied:
#        rm -f sdkconfig && idf.py build flash
#
# sdkconfig.defaults.local is gitignored and must never be committed.
# This AP is operator ingress only; LED nodes are controlled over Thread/Matter.
CONFIG_LED_ORCHESTRA_WIFI_AP_SSID="change-me-ssid"
CONFIG_LED_ORCHESTRA_WIFI_AP_PASSWORD="change-me-to-a-strong-password"
```

## matter-prototype/led-node/main/Kconfig.projbuild
```kconfig
menu "LED Orchestra Matter LED Node"

config LED_ORCHESTRA_NODE_ID
    int "Default LED Orchestra node id"
    default 1
    range 1 65535

config LED_ORCHESTRA_LED_GPIO
    int "WS2812 data GPIO"
    default 2
    range 0 30

config LED_ORCHESTRA_LED_COUNT
    int "Physical LEDs driven by this node"
    default 60
    range 1 900

config LED_ORCHESTRA_SEGMENT_START
    int "Default segment start in the virtual strip"
    default 0
    range 0 65535

config LED_ORCHESTRA_SEGMENT_LENGTH
    int "Default segment length"
    default 60
    range 1 900

config LED_ORCHESTRA_TOTAL_LEDS
    int "Default total virtual strip LEDs"
    default 60
    range 1 65535

config LED_ORCHESTRA_SW_VERSION
    int "Device software version (Matter OTA)"
    default 1
    help
        The Matter device software version reported in QueryImage and stamped into
        OTA images. The OTA provider offers an image to a node only when the image
        version is higher than the node's current version, so bump this for every
        OTA target build (e.g. build the update image with
        CONFIG_LED_ORCHESTRA_SW_VERSION=2). Append-only: never reuse/lower a
        shipped version. See matter-prototype/s3-h2-hub-validation/phase-7-offline-ota.md.

config LED_ORCHESTRA_SW_VERSION_STR
    string "Device software version string (Matter OTA)"
    default "1.0.0"
    help
        Human-readable software version string reported alongside
        LED_ORCHESTRA_SW_VERSION. Keep it in step with the numeric version.

config LED_ORCHESTRA_USE_FASTLED
    bool "Back the color/effect engine with real FastLED (hardware-gated spike)"
    default n
    help
        When enabled, the led_color.h engine aliases its types/helpers to real
        FastLED (<FastLED.h>) instead of the built-in FastLED-compatible
        fallback. This is the FastLED integration spike and requires vendoring
        FastLED as an ESP-IDF component. FastLED stays the color/effect MATH
        engine only; physical output stays on the ESP-IDF led_strip RMT path
        until a FastLED-output spike is proven on ESP32-C6 with Matter/Thread/
        BLE/OTA active. Leave OFF until that spike passes (see
        docs/matter-thread.md, "FastLED Engine").

endmenu
```

## matter-prototype/led-node/sdkconfig.defaults
```kconfig
# ESP32-C6 Matter-over-Thread LED node prototype target.
CONFIG_IDF_TARGET="esp32c6"
# Deployment standard is ESP32-C6-WROOM-1-N8 (8 MB) — see
# docs/led-node-flash-sizing-decision.md. For 4 MB (N4) units, set _4MB here and
# point CONFIG_PARTITION_TABLE_CUSTOM_FILENAME back at partitions.csv.
CONFIG_ESPTOOLPY_FLASHSIZE_8MB=y
CONFIG_LIBSODIUM_USE_MBEDTLS_SHA=y
CONFIG_MBEDTLS_HKDF_C=y

CONFIG_BT_ENABLED=y
CONFIG_BT_NIMBLE_ENABLED=y
CONFIG_BT_NIMBLE_EXT_ADV=n
CONFIG_USE_BLE_ONLY_FOR_COMMISSIONING=n

CONFIG_OPENTHREAD_ENABLED=y
CONFIG_OPENTHREAD_SRP_CLIENT=y
CONFIG_OPENTHREAD_DNS_CLIENT=y
CONFIG_OPENTHREAD_LOG_LEVEL_DYNAMIC=n
CONFIG_OPENTHREAD_LOG_LEVEL_NOTE=y
CONFIG_OPENTHREAD_CLI=n

CONFIG_LWIP_IPV6_AUTOCONFIG=n
CONFIG_LWIP_IPV6_NUM_ADDRESSES=8
CONFIG_LWIP_MULTICAST_PING=y
CONFIG_USE_MINIMAL_MDNS=n
CONFIG_ENABLE_EXTENDED_DISCOVERY=y
CONFIG_ENABLE_WIFI_STATION=n

CONFIG_PARTITION_TABLE_CUSTOM=y
CONFIG_PARTITION_TABLE_CUSTOM_FILENAME="partitions-8mb.csv"

CONFIG_ENABLE_CHIP_SHELL=y

CONFIG_LED_ORCHESTRA_NODE_ID=1
CONFIG_LED_ORCHESTRA_LED_GPIO=2
# LED_COUNT is the per-node renderer BUFFER CAP (max LEDs any single node can
# drive), NOT a fleet-wide constant: the same firmware serves a 400-LED node and a
# 900-LED node. Each node's actual count is provisioned at runtime via SetNodeConfig
# (segment_len, persisted in NVS) and clamped to this cap (see renderer.cpp). Only
# raise this value + the Kconfig `range` and rebuild if a node must drive MORE LEDs
# than this. SEGMENT_*/TOTAL below are first-boot defaults until a node is provisioned.
CONFIG_LED_ORCHESTRA_LED_COUNT=900
CONFIG_LED_ORCHESTRA_SEGMENT_START=0
CONFIG_LED_ORCHESTRA_SEGMENT_LENGTH=900
CONFIG_LED_ORCHESTRA_TOTAL_LEDS=900

# LED node is the Matter OTA Requestor: it pulls signed/encrypted images from
# the hub OTA Provider over the offline Thread fabric (the OTA phase). Keep the
# requestor cluster available early, but leave encrypted-image plumbing for the
# OTA phase so this prototype app does not require a PEM key blob. Matter fabric
# credentials and firmware image signing/encryption are separate security layers.
CONFIG_ENABLE_OTA_REQUESTOR=y
CONFIG_ENABLE_ENCRYPTED_OTA=n

# Brick protection for field-installed nodes. With rollback enabled the bootloader
# boots a freshly-applied OTA image in PENDING_VERIFY; if the app never confirms it
# (see the Thread-attach health gate in app_main.cpp) the bootloader reverts to the
# last-known-good slot on the next reset. This is keep-last-valid extended to
# firmware: a bad OTA can no longer brick a node we can't reach over USB.
# NOTE: CONFIG_BOOTLOADER_APP_ANTI_ROLLBACK (secure-version downgrade prevention)
# stays OFF — it is a field-security item that ships with secure boot / signed
# images, and enabling it without that flow can permanently lock out recovery.
CONFIG_BOOTLOADER_APP_ROLLBACK_ENABLE=y

# Point CHIP at the LED-node project config so the Matter device software version
# comes from CONFIG_LED_ORCHESTRA_SW_VERSION (bump it for every OTA target build).
CONFIG_CHIP_PROJECT_CONFIG="main/matter_project_config.h"
```
